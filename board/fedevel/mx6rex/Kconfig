## board/fedevel/mx6rex/Kconfig
```kconfig
if TARGET_MX6REX

config SYS_BOARD
	default "mx6rex"

config SYS_VENDOR
	default "fedevel"

config SYS_SOC
	default "mx6"

config SYS_CONFIG_NAME
	default "mx6rex"

endif
```

## board/fedevel/mx6tinyrex/Kconfig
```kconfig
if TARGET_MX6TINYREX

config SYS_BOARD
	default "mx6tinyrex"

config SYS_VENDOR
	default "fedevel"

config SYS_SOC
	default "mx6"

config SYS_CONFIG_NAME
	default "mx6tinyrex"

endif
```

## board/mrd/earthlogger/Kconfig
```kconfig
if TARGET_EARTHLOGGER

config SYS_BOARD
	default "earthlogger"

config SYS_VENDOR
	default "mrd"

config SYS_SOC
	default "mx6"

config SYS_CONFIG_NAME
	default "earthlogger"

endif
```

## configs/earthlogger_defconfig
```kconfig
CONFIG_SYS_EXTRA_OPTIONS="IMX_CONFIG=board/mrd/earthlogger/earthlogger.cfg,MX6Q,DDR_SIZE=SZ_2G,ENV_IS_IN_MMC,MODULE_TYPE_PREFIX=\"imx6\",MODULE_TYPE_POSTFIX=\"max\""
CONFIG_ARM=y
CONFIG_TARGET_EARTHLOGGER=y
CONFIG_DM=y
CONFIG_DM_THERMAL=y
```

## configs/earthloggerrecovery_defconfig
```kconfig
CONFIG_SYS_EXTRA_OPTIONS="IMX_CONFIG=board/mrd/earthlogger/earthloggerrecovery.cfg,MX6Q,DDR_SIZE=SZ_2G,ENV_IS_IN_SPI_FLASH,MODULE_TYPE_PREFIX=\"imx6\",MODULE_TYPE_POSTFIX=\"max\""
CONFIG_ARM=y
CONFIG_TARGET_EARTHLOGGER=y
CONFIG_DM=y
CONFIG_DM_THERMAL=y
```

## configs/mx6dlrex_defconfig
```kconfig
CONFIG_SYS_EXTRA_OPTIONS="IMX_CONFIG=board/fedevel/mx6rex/mx6dlrex.cfg,MX6DL,DDR_SIZE=SZ_2G,ENV_IS_IN_SPI_FLASH,MODULE_TYPE_PREFIX=\"imx6dl\",MODULE_TYPE_POSTFIX=\"\""
CONFIG_ARM=y
CONFIG_TARGET_MX6REX=y
CONFIG_DM=y
CONFIG_DM_THERMAL=y
```

## configs/mx6dltinyrex_defconfig
```kconfig
CONFIG_SYS_EXTRA_OPTIONS="IMX_CONFIG=board/fedevel/mx6tinyrex/mx6dltinyrex.cfg,MX6DL,DDR_SIZE=SZ_1G,ENV_IS_IN_MMC,MODULE_TYPE_PREFIX=\"imx6dl\",MODULE_TYPE_POSTFIX=\"\""
CONFIG_ARM=y
CONFIG_TARGET_MX6TINYREX=y
CONFIG_DM=y
CONFIG_DM_THERMAL=y
```

## configs/mx6qtinyrex_defconfig
```kconfig
CONFIG_SYS_EXTRA_OPTIONS="IMX_CONFIG=board/fedevel/mx6tinyrex/mx6qtinyrex.cfg,MX6Q,DDR_SIZE=SZ_2G,ENV_IS_IN_MMC,MODULE_TYPE_PREFIX=\"imx6qp\",MODULE_TYPE_POSTFIX=\"\""
CONFIG_ARM=y
CONFIG_TARGET_MX6TINYREX=y
CONFIG_DM=y
CONFIG_DM_THERMAL=y
```

## configs/mx6rexpro_defconfig
```kconfig
CONFIG_SYS_EXTRA_OPTIONS="IMX_CONFIG=board/fedevel/mx6rex/mx6rexpro.cfg,MX6Q,DDR_SIZE=SZ_2G,ENV_IS_IN_SPI_FLASH,MODULE_TYPE_PREFIX=\"imx6\",MODULE_TYPE_POSTFIX=\"pro\""
CONFIG_ARM=y
CONFIG_TARGET_MX6REX=y
CONFIG_DM=y
CONFIG_DM_THERMAL=y
```

## configs/mx6rexprosd_defconfig
```kconfig
CONFIG_SYS_EXTRA_OPTIONS="IMX_CONFIG=board/fedevel/mx6rex/mx6rexprosd.cfg,MX6Q,DDR_SIZE=SZ_2G,ENV_IS_IN_MMC,MODULE_TYPE_PREFIX=\"imx6\",MODULE_TYPE_POSTFIX=\"prosd\""
CONFIG_ARM=y
CONFIG_TARGET_MX6REX=y
CONFIG_DM=y
CONFIG_DM_THERMAL=y
```

## configs/mx6rexultra_defconfig
```kconfig
CONFIG_SYS_EXTRA_OPTIONS="IMX_CONFIG=board/fedevel/mx6rex/mx6rexultra.cfg,MX6QP,DDR_SIZE=0xF0000000,ENV_IS_IN_SPI_FLASH,MODULE_TYPE_PREFIX=\"imx6\",MODULE_TYPE_POSTFIX=\"ultra\""
CONFIG_ARM=y
CONFIG_TARGET_MX6REX=y
CONFIG_DM=y
CONFIG_DM_THERMAL=y
```

## configs/mx6stinyrex_defconfig
```kconfig
CONFIG_SYS_EXTRA_OPTIONS="IMX_CONFIG=board/fedevel/mx6tinyrex/mx6stinyrex.cfg,MX6S,DDR_SIZE=SZ_1G,ENV_IS_IN_MMC,MODULE_TYPE_PREFIX=\"imx6s\",MODULE_TYPE_POSTFIX=\"\""
CONFIG_ARM=y
CONFIG_TARGET_MX6TINYREX=y
CONFIG_DM=y
CONFIG_DM_THERMAL=y
```

## configs/mx6tinyrexbasic_defconfig
```kconfig
CONFIG_SYS_EXTRA_OPTIONS="IMX_CONFIG=board/fedevel/mx6tinyrex/mx6tinyrexbasic.cfg,MX6S,DDR_SIZE=SZ_512M,ENV_IS_IN_MMC,MODULE_TYPE_PREFIX=\"imx6\",MODULE_TYPE_POSTFIX=\"basic\""
CONFIG_ARM=y
CONFIG_TARGET_MX6TINYREX=y
CONFIG_DM=y
CONFIG_DM_THERMAL=y
```

## configs/mx6tinyrexliterecovery_defconfig
```kconfig
CONFIG_SYS_EXTRA_OPTIONS="IMX_CONFIG=board/fedevel/mx6tinyrex/mx6tinyrexliterecovery.cfg,MX6S,DDR_SIZE=SZ_256M,ENV_IS_IN_SPI_FLASH,MODULE_TYPE_PREFIX=\"imx6\",MODULE_TYPE_POSTFIX=\"lite\""
CONFIG_ARM=y
CONFIG_TARGET_MX6TINYREX=y
CONFIG_DM=y
CONFIG_DM_THERMAL=y
```

## configs/mx6tinyrexmax4g_defconfig
```kconfig
CONFIG_SYS_EXTRA_OPTIONS="IMX_CONFIG=board/fedevel/mx6tinyrex/mx6tinyrexmax4g.cfg,MX6Q,DDR_SIZE=0xF0000000,ENV_IS_IN_MMC,MODULE_TYPE_PREFIX=\"imx6\",MODULE_TYPE_POSTFIX=\"max4g\""
CONFIG_ARM=y
CONFIG_TARGET_MX6TINYREX=y
CONFIG_DM=y
CONFIG_DM_THERMAL=y
```

## configs/mx6tinyrexmax_defconfig
```kconfig
CONFIG_SYS_EXTRA_OPTIONS="IMX_CONFIG=board/fedevel/mx6tinyrex/mx6tinyrexmax.cfg,MX6Q,DDR_SIZE=SZ_2G,ENV_IS_IN_MMC,MODULE_TYPE_PREFIX=\"imx6\",MODULE_TYPE_POSTFIX=\"max\""
CONFIG_ARM=y
CONFIG_TARGET_MX6TINYREX=y
CONFIG_DM=y
CONFIG_DM_THERMAL=y
```

## configs/mx6tinyrexprorecovery_defconfig
```kconfig
CONFIG_SYS_EXTRA_OPTIONS="IMX_CONFIG=board/fedevel/mx6tinyrex/mx6tinyrexprorecovery.cfg,MX6Q,DDR_SIZE=SZ_1G,ENV_IS_IN_SPI_FLASH,MODULE_TYPE_PREFIX=\"imx6\",MODULE_TYPE_POSTFIX=\"pro\""
CONFIG_ARM=y
CONFIG_TARGET_MX6TINYREX=y
CONFIG_DM=y
CONFIG_DM_THERMAL=y
```

## configs/mx6tinyrexultrarecovery_defconfig
```kconfig
CONFIG_SYS_EXTRA_OPTIONS="IMX_CONFIG=board/fedevel/mx6tinyrex/mx6tinyrexultrarecovery.cfg,MX6QP,DDR_SIZE=0xF0000000,ENV_IS_IN_SPI_FLASH,MODULE_TYPE_PREFIX=\"imx6\",MODULE_TYPE_POSTFIX=\"ultra\""
CONFIG_ARM=y
CONFIG_TARGET_MX6TINYREX=y
CONFIG_DM=y
CONFIG_DM_THERMAL=y
```
